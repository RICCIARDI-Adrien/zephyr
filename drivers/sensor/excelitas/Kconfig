## drivers/sensor/excelitas/Kconfig
```kconfig
# Copyright (c) 2026 BayLibre <https://baylibre.com>
# SPDX-License-Identifier: Apache-2.0

source "drivers/sensor/excelitas/tpi1s1385/Kconfig"
```

## dts/bindings/sensor/excelitas,tpi1s1385.yaml
```yaml
# Copyright (c) 2026 BayLibre <https://baylibre.com>
# SPDX-License-Identifier: Apache-2.0

description: |
  Excelitas CaliPile TPiS 1S 1385 infrared thermopile sensor.

  Product page:
    https://www.excelitas.com/fr/product/tpis-1s-1385-calipile-sensor-smd

compatible: "excelitas,tpi1s1385"

include: [sensor-device.yaml, i2c-device.yaml]

properties:
  int-gpios:
    type: phandle-array
    description: |
      GPIO wired to the open drain active low INT pin of the sensor.

  slp1:
    type: int
    default: 1
    description: |
      Select code for the low pass filter LP1 time constant. This field
      occupies bits 3:0 of register 0x14. The binary codes 0110 and 0111
      are reserved by the datasheet and therefore not accepted. The
      datasheet recommends the value 11 (one second) for the presence
      detection use case.
    enum:
      - 0
      - 1
      - 2
      - 3
      - 4
      - 5
      - 8
      - 9
      - 10
      - 11
      - 12
      - 13

  slp2:
    type: int
    default: 8
    description: |
      Select code for the low pass filter LP2 time constant. This field
      occupies bits 7:4 of register 0x14. The binary codes 0110 and 0111
      are reserved by the datasheet and therefore not accepted. The
      datasheet recommends the value 8 (eight seconds) for the presence
      detection use case.
    enum:
      - 0
      - 1
      - 2
      - 3
      - 4
      - 5
      - 8
      - 9
      - 10
      - 11
      - 12
      - 13

  slp3:
    type: int
    default: 2
    description: |
      Select code for the low pass filter LP3 time constant. This field
      occupies bits 3:0 of register 0x15. The binary codes 0110 and 0111
      are reserved by the datasheet and therefore not accepted. The
      datasheet recommends the value 10 (two seconds) for the ambient
      temperature shock detection use case.
    enum:
      - 0
      - 1
      - 2
      - 3
      - 4
      - 5
      - 8
      - 9
      - 10
      - 11
      - 12
      - 13

  src-select:
    type: int
    default: 1
    description: |
      Selects the pair of signals subtracted to produce the presence
      counter. This field occupies bits 3:2 of register 0x1A. The value 0
      selects TPobject minus TPobjLP2. The value 1 selects TPobjLP1 minus
      TPobjLP2 and is the recommended combination. The value 2 selects
      TPobject minus TPobjLP2 frozen. The value 3 selects TPobjLP1 minus
      TPobjLP2 frozen.
    enum:
      - 0
      - 1
      - 2
      - 3

  cycle-time:
    type: int
    default: 2
    description: |
      Cycle time used for the motion differentiation. This field occupies
      bits 1:0 of register 0x1A. The value 0 selects 30 ms, the value 1
      selects 60 ms, the value 2 selects 120 ms and is the recommended
      setting, and the value 3 selects 140 ms.
    enum:
      - 0
      - 1
      - 2
      - 3

  tpot-direction:
    type: int
    default: 0
    description: |
      Direction of the TPOT threshold. This field occupies bit 4 of
      register 0x1A. The value 0 fires an interrupt when TPobject falls
      below the threshold. The value 1 fires an interrupt when TPobject
      exceeds the threshold.
    enum:
      - 0
      - 1

  presence-threshold:
    type: int
    min: 0
    max: 255
    default: 50
    description: |
      Unsigned eight bit threshold written to register 0x16. Accepted
      values run from 0 to 255. The datasheet recommends 50.

  motion-threshold:
    type: int
    min: 0
    max: 255
    default: 10
    description: |
      Unsigned eight bit threshold written to register 0x17. Accepted
      values run from 0 to 255. The datasheet recommends 10.

  amb-shock-threshold:
    type: int
    min: 0
    max: 255
    default: 10
    description: |
      Unsigned eight bit threshold written to register 0x18. Accepted
      values run from 0 to 255. The datasheet recommends 10.
```

## soc/renesas/rcar/rcar_gen5/Kconfig
```kconfig
# Copyright (c) 2025 BayLibre, SAS
# SPDX-License-Identifier: Apache-2.0

config SOC_R8A78000_R52
	select ARM
	select CPU_CORTEX_R52
	select GIC_SINGLE_SECURITY_STATE
	select CLOCK_CONTROL_RCAR_CPG_MSSR if CLOCK_CONTROL
	select ARM_ARCH_TIMER
```

## soc/renesas/rcar/rcar_gen5/Kconfig.defconfig
```kconfig
# Copyright (c) 2025 BayLibre, SAS
# SPDX-License-Identifier: Apache-2.0

if SOC_SERIES_RCAR_GEN5

config NUM_IRQS
	default 1216 #960 SPI + 256 LPI TODO

endif # SOC_SERIES_RCAR_GEN5
```
