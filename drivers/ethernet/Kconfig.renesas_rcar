## drivers/ethernet/Kconfig.renesas_rcar
```kconfig
# Copyright (c) 2026 BayLibre, SAS
# SPDX-License-Identifier: Apache-2.0

config ETH_RENESAS_RCAR_RSWITCH
	bool "Renesas R-Car R-Switch Ethernet"
	default y
	depends on DT_HAS_RENESAS_RCAR_RSWITCH_ENABLED
	help
	  Enable the Renesas R-Car R-Switch Ethernet driver.
	  Currently only the R-Switch 3 is supported.

if ETH_RENESAS_RCAR_RSWITCH

# TODO

endif
```

## drivers/ethernet/mdio/Kconfig.renesas_rcar
```kconfig
# Copyright 2026 BayLibre, SAS
# SPDX-License-Identifier: Apache-2.0

config MDIO_RENESAS_RCAR_RSWITCH
	bool "Renesas R-Car R-Switch MDIO driver"
	default y
	depends on DT_HAS_RENESAS_RCAR_RSWITCH_MDIO_ENABLED
	depends on ETH_RENESAS_RCAR_RSWITCH
	help
	  Enable the R-Car R-Switch MDIO driver.
```

## drivers/pwm/Kconfig.rcar5
```kconfig
# Renesas R-Car Gen5 PWM configuration options

# Copyright (c) 2026 BayLibre, SAS
# SPDX-License-Identifier: Apache-2.0

config PWM_RCAR5
	bool "Renesas R-Car Gen5 PWM driver"
	default y
	depends on DT_HAS_RENESAS_PWM_RCAR5_ENABLED
	select PINCTRL
	help
	  Enable the PWM driver for Renesas R-Car Gen5 SoCs.
```

## dts/bindings/ethernet/mdio/renesas,rcar-rswitch-mdio.yaml
```yaml
# Copyright (c) 2026 BayLibre, SAS
# SPDX-License-Identifier: Apache-2.0

description: Renesas R-Car R-Switch MDIO driver node

compatible: "renesas,rcar-rswitch-mdio"

include: mdio-controller.yaml

on-bus: rcar
```

## dts/bindings/ethernet/renesas,rcar-rswitch-tsn.yaml
```yaml
# Copyright (c) 2026 BayLibre, SAS
# SPDX-License-Identifier: Apache-2.0

description: Renesas R-Car R-Switch Ethernet Time Sensitive Networking End Station

compatible: "renesas,rcar-rswitch-tsn"

include:
  - ethernet-controller.yaml
  - ethernet-mac-address.yaml

properties:
  id:
    type: int
    required: true
    description: |
      TODO s'inspirer de CAN

  # TODO déjà défini dans ethernet-controller, utile de le redéfinir ?
  phy-handle:
    type: phandle
    description: Specify a reference to a node representing a PHY device.

  local-mac-address:
    type: uint8-array
    description: Specify the MAC address that is assigned to the Ethernet controller port.

  phy-connection-type:
    required: true
```

## dts/bindings/ethernet/renesas,rcar-rswitch.yaml
```yaml
# Copyright (c) 2026 BayLibre, SAS
# SPDX-License-Identifier: Apache-2.0

description: Renesas R-Car R-Switch Ethernet

compatible: "renesas,rcar-rswitch"

include: ethernet-controller.yaml

properties:
  reg:
    required: true

  coma-reg-offset:
    type: int
    required: true
    description: |
      The COMA registers offset from the beginning of the R-Switch 3 secure range.
      Also called CARO offset in the TOP documentation.

  ports:
    type: array

child-binding:
  #child-binding:

  description: Port properties

  include: ethernet-mac-address.yaml


  properties:
    # TODO
    #id:
    #  type: int

    phy-handle:
      type: phandle
      description: Specify a reference to a node representing a PHY device.

    lsocal-mac-address:
      type: uint8-array
      description: Specify the MAC address that is assigned to the Ethernet controller port.

   # zephyr,random-mac-address;

    # TODO
  #interrupts:
  #  required: true

  #phy-handle:
  #  required: true
```

## dts/bindings/ethernet/renesas,rcar-rswitch3.yaml
```yaml
# Copyright (c) 2026 BayLibre, SAS
# SPDX-License-Identifier: Apache-2.0

description: Renesas R-Car R-Switch 3 Ethernet

compatible: "renesas,rcar-rswitch3"

include: ethernet-controller.yaml

properties:
  reg:
    required: true

  ports:
    type: array

child-binding:
  child-binding:

    description: Port properties

    properties:
      # TODO
      id:
        type: int

      phy-handle:
        type: phandle
        description: Specify a reference to a node representing a PHY device.

      local-mac-address:
        type: uint8-array
        description: Specify the MAC address that is assigned to the Ethernet controller port.

    # TODO
  #interrupts:
  #  required: true

  #phy-handle:
  #  required: true
```

## dts/bindings/pwm/renesas,pwm-rcar.yaml
```yaml
# Copyright (c) 2022, IoT.bzh
# SPDX-License-Identifier: Apache-2.0

description: |
  Renesas R-Car PWM controller.

  On Gen5, each channel has 0x1000 bytes of registers, so the number of
  channels is the size of reg divided by 0x1000. The controller at 0xc0740000
  holds PWM0 to PWM3 and the one at 0xc0780000 holds PWM4 to PWM9. The first
  clock is the module clock and the second one is the counter clock.

  A stopped Gen5 channel stays high, so a 100% duty cycle works, but 0% and
  inverted polarity are not supported.

compatible: "renesas,pwm-rcar"

include: [pwm-controller.yaml, pinctrl-device.yaml, base.yaml]

properties:
  "#pwm-cells":
    const: 3

pwm-cells:
  - channel
  # period in terms of nanoseconds
  - period
  - flags
```

## dts/bindings/pwm/renesas,pwm-rcar5.yaml
```yaml
# Copyright (c) 2026 BayLibre, SAS
# SPDX-License-Identifier: Apache-2.0

description: |
  Renesas R-Car Gen5 PWM controller.

  Each channel has 0x1000 bytes of registers, so the number of channels is
  the size of reg divided by 0x1000. The controller at 0xc0740000 holds PWM0
  to PWM3 and the one at 0xc0780000 holds PWM4 to PWM9.

  A stopped channel stays high, so a 100% duty cycle works, but 0% and
  inverted polarity are not supported.

compatible: "renesas,pwm-rcar5"

include: [pwm-controller.yaml, base.yaml, pinctrl-device.yaml]

properties:
  reg:
    required: true

  clocks:
    required: true
    description: |
      The module clock first, then the counter clock that sets the PWM
      frequency.

  "#pwm-cells":
    const: 3

pwm-cells:
  - channel
  # period in terms of nanoseconds
  - period
  - flags
```
