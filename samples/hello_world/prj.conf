## CMakeLists.txt
```
# SPDX-License-Identifier: Apache-2.0

cmake_minimum_required(VERSION 3.20.0)

find_package(Zephyr REQUIRED HINTS $ENV{ZEPHYR_BASE})
project(hello_world)

target_sources(app PRIVATE src/main.c)

add_custom_command(
  OUTPUT include/factory_nvs.h
  COMMAND ${APPLICATION_SOURCE_DIR}/generate-factory-nvs.sh
  COMMAND
    ZEPHYR_BASE=${ZEPHYR_BASE}
    APPLICATION_BINARY_DIR=${APPLICATION_BINARY_DIR}
    NVS_FACTORY_TOOL_SOURCES=${APPLICATION_SOURCE_DIR}/nvs_factory_test.c
    make -C ${APPLICATION_SOURCE_DIR}/nvs_factory_tool
  COMMAND ${APPLICATION_SOURCE_DIR}/nvs_factory_tool/nvs-factory-tool
  DEPENDS zephyr_generated_headers
)
target_sources(app PRIVATE include/factory_nvs.h)
target_include_directories(app PRIVATE ${APPLICATION_BINARY_DIR}/include)
```

## prj.conf
```kconfig
CONFIG_ARM_SCMI_POLLING_ONLY=y
CONFIG_PINCTRL_RCAR_SCMI=n
CONFIG_PM_DEVICE=y

#CONFIG_USE_SWITCH=y
```

## src/main.c
```c
/*
 * Copyright (c) 2012-2014 Wind River Systems, Inc.
 *
 * SPDX-License-Identifier: Apache-2.0
 */

#include <stdio.h>
#include <zephyr/kernel.h>
#include <zephyr/sys/util.h>

int main(void)
{
	printf("Hello World! %s\n", CONFIG_BOARD_TARGET);
	printf("k_cycle_get_32()=%u\n", k_cycle_get_32());

	printf("Z_SPIN_DELAY(10)\n");
	Z_SPIN_DELAY(10);

	uint32_t _wf_cycle_count = k_us_to_cyc_ceil32(10);
	printf("k_us_to_cyc_ceil32(10)=%u\n", _wf_cycle_count);

	printf("k_sleep_ticks\n");
	k_ticks_t ticks = k_sleep_ticks(K_USEC(10));

	//printk("msleep\n");
	//k_msleep(3);

	printf("FIN OK\n");

	return 0;
}
```
